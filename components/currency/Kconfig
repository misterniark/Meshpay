## components/currency/Kconfig
```kconfig
# Kconfig du composant currency (Mesh Pay)
#
# Options de TEST exclusivement. Toute option declaree ici doit etre
# protegee par un garde-fou Release qui empeche son activation dans
# un binaire de production (cf. #error dans currency_rules.c).

menu "Mesh Pay currency (TEST options)"

    config MESHPAY_TEST_SKIP_MINT_AUTHORITY
        bool "TEST ONLY: bypass mint authority verification"
        default n
        help
            DANGER : si actif, currency_check_mint_authority() retourne
            CURRENCY_OK pour toute cle signataire, et un ESP_LOGW est
            emis a chaque appel ("MINT AUTH BYPASSED — TEST MODE").

            Permet de tester la propagation des MINT entre devices
            sur table sans avoir a partager une mint authority commune
            entre les firmwares.

            Garde-fou : un #error dans currency_rules.c empeche la
            compilation si cette option est activee en mode
            SECURE_FLASH_ENCRYPTION_MODE_RELEASE. Impossible donc de
            produire un binaire de production avec ce bypass actif.

            A laisser systematiquement OFF en production.

    config MESHPAY_TEST_DEVICE_SEED
        bool "TEST ONLY: seed each device with an idempotent self-MINT"
        default n
        help
            DANGER : option de banc de test uniquement. Quand elle est active,
            chaque device cree une fois par identifiant de campagne un MINT
            signe par sa propre keypair vers sa propre pubkey.

            L'id de campagne est stocke en NVS. Tant que l'id ne change pas,
            le seed n'est pas rejoue au reboot. Changer l'id permet de lancer
            une nouvelle campagne de test sans effacer toute la NVS.

            Garde-fou : un #error dans main.c empeche la compilation si cette
            option est activee en mode SECURE_FLASH_ENCRYPTION_MODE_RELEASE.

    config MESHPAY_TEST_DEVICE_SEED_AMOUNT
        int "TEST ONLY: per-device seed amount"
        depends on MESHPAY_TEST_DEVICE_SEED
        default 10
        range 1 1000000

    config MESHPAY_TEST_DEVICE_SEED_ID
        string "TEST ONLY: per-device seed campaign id"
        depends on MESHPAY_TEST_DEVICE_SEED
        default "test-seed-v1"
        help
            Identifiant de campagne stocke en NVS. Changer cette valeur force
            un nouveau seed de test sur chaque device.

endmenu
```

## components/debug_console/Kconfig
```kconfig
# Kconfig du composant debug_console (Mesh Pay)
#
# Console serie de debug qui expose des commandes de dump JSON
# (dump_dag, dump_wallet, dump_currency, dump_time) consommables
# par un moniteur externe Python pour observer la convergence DAG
# et la propagation LoRa entre devices pendant les tests terrain.
#
# Gate sur SECURE_FLASH_ENCRYPTION_MODE_RELEASE : tant qu'on est en
# mode DEVELOPMENT (prototype), le debug est actif par defaut. Des que
# le mode RELEASE est selectionne (production), il est desactive
# automatiquement — le code entier est strippe par le linker (zero
# octet flash, zero octet RAM, zero surface d'attaque).

menu "Mesh Pay debug console"

    config MESHPAY_DEBUG_CONSOLE
        bool "Enable serial debug console (dump_dag, dump_wallet, ...)"
        default y if !SECURE_FLASH_ENCRYPTION_MODE_RELEASE
        default n
        help
            Active la console serie de debug. Commandes disponibles :
            dump_dag, dump_wallet, dump_currency, dump_time, dump_all,
            help. La sortie est encadree par des marqueurs textuels
            (<<<MESHPAY_DEBUG ... BEGIN/END>>>) pour etre distinguable
            des ESP_LOGI qui coulent en parallele sur la meme UART.

            A laisser desactive en production : la commande dump_*
            expose le contenu du DAG (historique des transactions,
            cles publiques des pairs) en clair sur le port serie.

    config MESHPAY_DEBUG_CONSOLE_TASK_STACK
        int "Stack size of debug console task (bytes)"
        depends on MESHPAY_DEBUG_CONSOLE
        default 4096
        help
            Taille de pile pour la tache qui lit les commandes UART et
            execute les callbacks de dump. 4096 octets suffisent pour
            une iteration sur 250 TX avec serialisation JSON ligne par
            ligne (le buffer ligne lui-meme reste sur la stack).

    config MESHPAY_DEBUG_CONSOLE_TASK_PRIO
        int "Priority of debug console task"
        depends on MESHPAY_DEBUG_CONSOLE
        default 2
        help
            Priorite basse : la console de debug ne doit jamais
            preempter les taches metier (core_task=6, espnow_task=7,
            lora_task=5, ui_task=4). Au-dessus de stkmon (1) pour
            que les commandes restent reactives.

    config MESHPAY_DEBUG_CONSOLE_LINE_BUF_SIZE
        int "Max length of a debug input/output line (bytes)"
        depends on MESHPAY_DEBUG_CONSOLE
        default 384
        help
            Taille du buffer ligne utilise pour parser une commande
            entrante et pour formater une ligne JSON sortante. 384
            couvre la plus grosse ligne TX serialisee (id + from + to
             + parents en hex = ~300 caracteres).

    config MESHPAY_DEBUG_CONSOLE_MUTEX_TIMEOUT_MS
        int "Mutex acquisition timeout in dumps (ms)"
        depends on MESHPAY_DEBUG_CONSOLE
        default 1000
        help
            Delai max d'attente du mutex applicatif pour une commande
            de dump. Si depasse, le dump est avorte avec une trame
            d'erreur — pas de blocage durable.

endmenu
```

## components/device_hal/Kconfig
```kconfig
menu "Mesh Pay - LoRa"

choice MESHPAY_LORA_DRIVER
    prompt "Driver radio LoRa"
    default MESHPAY_LORA_DRIVER_CORE1262
    help
        Choix du module radio LoRa. Le LoRa est obligatoire sur tous les
        devices ; cette option choisit uniquement quel driver materiel est
        compile. Le code applicatif passe par hal_lora_create_default().

    config MESHPAY_LORA_DRIVER_WIO_E5
        bool "Grove Wio-E5 (UART / commandes AT)"

    config MESHPAY_LORA_DRIVER_CORE1262
        bool "Waveshare Core1262 (SX1262, SPI)"
endchoice

# --- Pins Core1262 (SX1262 SPI) — utilises si CORE1262 ---
# Defauts verifies sur les schemas officiels Waveshare : header
# d'extension P1 de l'ESP32-S3-Touch-LCD-1.47, GPIO IO1-IO11 libres.
# SPI3_HOST = 2 dans l'enumeration spi_host_device_t d'ESP-IDF.
config MESHPAY_LORA_C1262_SPI_HOST
    int "Core1262 : hote SPI"
    depends on MESHPAY_LORA_DRIVER_CORE1262
    default 2

config MESHPAY_LORA_C1262_PIN_SCK
    int "Core1262 : GPIO SCK"
    depends on MESHPAY_LORA_DRIVER_CORE1262
    default 1

config MESHPAY_LORA_C1262_PIN_MOSI
    int "Core1262 : GPIO MOSI"
    depends on MESHPAY_LORA_DRIVER_CORE1262
    default 2

config MESHPAY_LORA_C1262_PIN_MISO
    int "Core1262 : GPIO MISO"
    depends on MESHPAY_LORA_DRIVER_CORE1262
    default 10
    help
        GPIO sur lequel le SX1262 emet sa ligne MISO (input cote ESP32).

        DEPLACE de GPIO3 a GPIO10 (mai 2026) : GPIO3 sur ESP32-S3 est
        un strapping pin qui controle la source du signal JTAG au boot.
        Avec la console USB-Serial-JTAG active (cf. sdkconfig.defaults.
        esp32s3), brancher MISO sur GPIO3 rendait l'init SX1262
        instable selon l'etat haute-impedance du module au boot et,
        combine au bug F-LT-001, crashait le firmware au premier
        paiement recu (NULL deref sur s_lora_hal.send).

config MESHPAY_LORA_C1262_PIN_NSS
    int "Core1262 : GPIO NSS (chip-select)"
    depends on MESHPAY_LORA_DRIVER_CORE1262
    default 4

config MESHPAY_LORA_C1262_PIN_RESET
    int "Core1262 : GPIO RESET"
    depends on MESHPAY_LORA_DRIVER_CORE1262
    default 5

config MESHPAY_LORA_C1262_PIN_BUSY
    int "Core1262 : GPIO BUSY"
    depends on MESHPAY_LORA_DRIVER_CORE1262
    default 6

config MESHPAY_LORA_C1262_PIN_DIO1
    int "Core1262 : GPIO DIO1 (IRQ)"
    depends on MESHPAY_LORA_DRIVER_CORE1262
    default 7

config MESHPAY_LORA_C1262_PIN_RXEN
    int "Core1262 : GPIO RXEN (switch RF RX)"
    depends on MESHPAY_LORA_DRIVER_CORE1262
    default 8

config MESHPAY_LORA_C1262_PIN_TXEN
    int "Core1262 : GPIO TXEN (switch RF TX)"
    depends on MESHPAY_LORA_DRIVER_CORE1262
    default 9

# --- Pins Wio-E5 (UART/AT) — utilises si WIO_E5 ---
# Anciennement des #define dans main/transport/transport_lora.c.
config MESHPAY_LORA_WIOE5_UART_NUM
    int "Wio-E5 : numero de port UART"
    depends on MESHPAY_LORA_DRIVER_WIO_E5
    default 2

config MESHPAY_LORA_WIOE5_PIN_TX
    int "Wio-E5 : GPIO TX"
    depends on MESHPAY_LORA_DRIVER_WIO_E5
    default 17

config MESHPAY_LORA_WIOE5_PIN_RX
    int "Wio-E5 : GPIO RX"
    depends on MESHPAY_LORA_DRIVER_WIO_E5
    default 16

endmenu
```

## sdkconfig.defaults
```kconfig
# Configuration par défaut du projet
# Système de paiement décentralisé offline

# --- mbedtls : activer PSA Crypto pour Ed25519 ---
CONFIG_MBEDTLS_ECDSA_C=y
CONFIG_MBEDTLS_ECP_C=y
CONFIG_MBEDTLS_ECP_DP_CURVE25519_ENABLED=y
CONFIG_MBEDTLS_HKDF_C=y

# --- Partition custom (2x OTA 1.75 MB + NVS + SPIFFS) ---
CONFIG_PARTITION_TABLE_CUSTOM=y
CONFIG_PARTITION_TABLE_CUSTOM_FILENAME="partitions.csv"

# --- FreeRTOS ---
CONFIG_FREERTOS_HZ=1000

# --- LVGL ---
CONFIG_LV_COLOR_DEPTH_16=y
CONFIG_LV_DRAW_BUF_STRIDE_ALIGN=1
CONFIG_LV_FONT_MONTSERRAT_14=y
CONFIG_LV_FONT_MONTSERRAT_20=y
CONFIG_LV_FONT_MONTSERRAT_28=y
CONFIG_LV_USE_LOG=y
CONFIG_LV_LOG_LEVEL_WARN=y
CONFIG_LV_TICK_CUSTOM=y

# ===================================================================
# SECURITE : Chiffrement flash + NVS chiffre
# ===================================================================
#
# MODE DEVELOPMENT : permet le reflashing via UART sans restriction.
# Pour la PRODUCTION, remplacer par :
#   CONFIG_SECURE_FLASH_ENCRYPTION_MODE_RELEASE=y
#   CONFIG_SECURE_UART_ROM_DL_MODE_DISABLED=y
#
# ATTENTION : L'activation brule des eFuses de maniere IRREVERSIBLE.
# En mode Release, le device ne peut plus etre reflashe en clair.
# ===================================================================

# --- Chiffrement flash (AES-256, mode developpement) ---
CONFIG_SECURE_FLASH_ENC_ENABLED=y
CONFIG_SECURE_FLASH_ENCRYPTION_MODE_DEVELOPMENT=y

# --- Bootloader elargi pour flash encryption ---
# Le bootloader avec flash encryption depasse 28KB (limite a 0x8000).
# On repousse la partition table a 0x10000 pour laisser 60KB au bootloader.
CONFIG_PARTITION_TABLE_OFFSET=0x10000

# --- NVS chiffre (cles protegees par le chiffrement flash) ---
CONFIG_NVS_ENCRYPTION=y
```

## sdkconfig.defaults.esp32
```kconfig
# Configuration spécifique ESP32 (CYD)
CONFIG_IDF_TARGET="esp32"
CONFIG_ESPTOOLPY_FLASHSIZE_4MB=y

# --- Secure Boot V2 (PRODUCTION UNIQUEMENT) ---
# Non active par defaut car necessite :
#   1. Un chip ESP32 revision >= 3.0 (ECO3)
#   2. CONFIG_ESP32_REV_MIN_3=y
#   3. Une cle RSA-3072 generee avec :
#      espsecure.py generate_signing_key --version 2 secure_boot_key.pem
#   4. Brulage irreversible des eFuses au premier boot
#
# Pour activer, decommenter :
# CONFIG_ESP32_REV_MIN_3=y
# CONFIG_SECURE_BOOT=y
# CONFIG_SECURE_BOOT_V2_ENABLED=y
# CONFIG_SECURE_BOOT_BUILD_SIGNED_BINARIES=y
```

## sdkconfig.defaults.esp32s3
```kconfig
# Configuration spécifique ESP32-S3 (Waveshare ESP32-S3-Touch-LCD-1.47)
CONFIG_IDF_TARGET="esp32s3"
CONFIG_ESPTOOLPY_FLASHSIZE_16MB=y

# --- Console serie sur USB-Serial-JTAG (USB-C natif, GPIO 19/20) ---
# Obligatoire : libere UART0 / GPIO 43-44, utilises pour cabler le
# module LoRa Wio-E5. Sans ce reglage, la console defaulterait sur
# UART0 et entrerait en conflit direct avec le Wio-E5.
CONFIG_ESP_CONSOLE_USB_SERIAL_JTAG=y

# --- PSRAM (8MB octal SPI) ---
CONFIG_ESP32S3_SPIRAM_SUPPORT=y
CONFIG_SPIRAM_MODE_OCT=y
CONFIG_SPIRAM_SPEED_80M=y

# --- Secure Boot V2 (PRODUCTION UNIQUEMENT) ---
# ESP32-S3 supporte nativement Secure Boot V2 (pas de restriction de revision).
# Non active par defaut car necessite :
#   1. Une cle RSA-3072 generee avec :
#      espsecure.py generate_signing_key --version 2 secure_boot_key.pem
#   2. Brulage irreversible des eFuses au premier boot
#
# Pour activer, decommenter :
# CONFIG_SECURE_BOOT=y
# CONFIG_SECURE_BOOT_V2_ENABLED=y
# CONFIG_SECURE_BOOT_BUILD_SIGNED_BINARIES=y

# --- Gestion de l'energie (feature 13) ---
# Active esp_pm pour le CPU frequency scaling en mode ECO.
# Phase 1 : frequency scaling seul (pas de light sleep). Le light sleep
# (CONFIG_FREERTOS_USE_TICKLESS_IDLE) viendra en Phase 2.
CONFIG_PM_ENABLE=y

# --- LoRa : la carte Waveshare (ESP32-S3) est equipee du module Core1262 ---
CONFIG_MESHPAY_LORA_DRIVER_CORE1262=y
```

## test_app/sdkconfig.defaults
```kconfig
# Mesh Pay Test App — Configuration commune
#
# Cible esp32s3 par defaut (carte de dev actuellement connectee).
# Pour basculer sur ESP32 CYD :
#   rm test_app/sdkconfig && idf.py -C test_app set-target esp32

# --- Console USB-OTG natif (Waveshare ESP32-S3-Touch-LCD-1.47) ---
CONFIG_ESP_CONSOLE_USB_SERIAL_JTAG=y

# --- Flash 16 MB + PSRAM octal 80 MHz (Waveshare 1.47") ---
CONFIG_ESPTOOLPY_FLASHSIZE_16MB=y
CONFIG_SPIRAM=y
CONFIG_SPIRAM_MODE_OCT=y
CONFIG_SPIRAM_SPEED_80M=y

# --- Stack des taches IDLE/main pour les tests (Unity utilise du stack) ---
# 80 KB : les tests DAG/wallet allouent un `dag_t` sur la stack (250 TX
# x ~250 octets = ~62 KB), donc la stack par defaut 16 KB explose
# silencieusement et bloque la session de tests des le premier appel
# a `dag_init(&dag)`.
CONFIG_ESP_MAIN_TASK_STACK_SIZE=81920
CONFIG_FREERTOS_IDLE_TASK_STACKSIZE=2048

# --- Desactiver le task watchdog : unity_run_menu() polle stdin en boucle
# bloquante sans yielder, ce qui declenche le WDT sur IDLE0. Sur un
# test app, le WDT n'a pas d'utilite (pas de production runtime). ---
# CONFIG_ESP_TASK_WDT_INIT is not set
# CONFIG_ESP_INT_WDT is not set

# --- Logs par defaut a INFO (Unity utilise printf direct, pas ESP_LOG) ---
CONFIG_LOG_DEFAULT_LEVEL_INFO=y
CONFIG_LOG_DEFAULT_LEVEL=3

# --- Unity : on garde l'option "menu" pour selectionner les tests
# interactivement via la console serie au demarrage.
# 64BIT obligatoire : plusieurs tests Mesh Pay comparent des uint64_t
# (timestamps Lamport, currency melt, etc.). ---
CONFIG_UNITY_ENABLE_COLOR=y
CONFIG_UNITY_ENABLE_BACKTRACE_ON_FAIL=y
CONFIG_UNITY_ENABLE_64BIT=y

# --- Crypto Mesh Pay : Curve25519 active pour compatibilite eventuelle
# avec d'anciennes parties du code (Monocypher est vendore par crypto) ---
CONFIG_MBEDTLS_ECP_DP_CURVE25519_ENABLED=y

# --- LVGL : configs requises par le composant `ui` Mesh Pay
# (fonts utilisees par ui_theme.c). Reprises de sdkconfig.defaults du
# firmware principal pour que le composant ui compile dans test_app. ---
CONFIG_LV_COLOR_DEPTH_16=y
CONFIG_LV_DRAW_BUF_STRIDE_ALIGN=1
CONFIG_LV_FONT_MONTSERRAT_14=y
CONFIG_LV_FONT_MONTSERRAT_20=y
CONFIG_LV_FONT_MONTSERRAT_28=y
CONFIG_LV_USE_LOG=y
CONFIG_LV_LOG_LEVEL_WARN=y

# --- Partitions : layout custom minimal pour test app ---
CONFIG_PARTITION_TABLE_CUSTOM=y
CONFIG_PARTITION_TABLE_CUSTOM_FILENAME="partitions.csv"
CONFIG_PARTITION_TABLE_FILENAME="partitions.csv"
```
